## conf/layer.conf
```bitbake
# We have a conf and classes directory, add to BBPATH
BBPATH .= ":${LAYERDIR}"
HOSTTOOLS:append =" python spatch bzcat lex yacc "

# We have recipes-* directories, add to BBFILES
BBFILES_IPQ += "${LAYERDIR}/recipes-*/*/*.bb \
	${LAYERDIR}/recipes-*/*/*/*.bb \
	${LAYERDIR}/recipes-*/*/*.bbappend"

BBFILES_SDX = "${LAYERDIR}/packagegroups/*.bb \
		${LAYERDIR}/recipes-wifi/*/*.bb \
		${LAYERDIR}/recipes-wifi/*/*/*.bb \
		${LAYERDIR}/recipes-wifi/*/*.bbappend \
		${LAYERDIR}/recipes-qcawifi/qca-hostapd/*.bb \
		${LAYERDIR}/recipes-debug-uio/*/*.bb \
		${LAYERDIR}/recipes-packages/wififw-mount/*.bb \
		${LAYERDIR}/recipes-packages/initoverlay/*.bb \
		${LAYERDIR}/recipes-qcawifi/qca-athdiag/*.bb \
		${LAYERDIR}/recipes-qcawifi/qca-cnssdiag/*.bb \
		${LAYERDIR}/recipes-qcaplatform/*/*.bb \
		${LAYERDIR}/recipes-qcawifi/qca-cfg80211/*.bb \
		${LAYERDIR}/recipes-qcawifi/qca-cfg80211tool/*.bb \
		${LAYERDIR}/recipes-qcawifi/qca-udtool/*.bb \
		${LAYERDIR}/recipes-qcawifi/qca-ath6kl-utils/*.bb \
		${LAYERDIR}/recipes-qcawifi/qca-ftm/*.bb \
		${LAYERDIR}/recipes-qcahalphy/*/*.bb \
		${LAYERDIR}/recipes-support/*/*.bb \
		${LAYERDIR}/recipes-support/*/*.bbappend \
		${LAYERDIR}/recipes-packages/ipq-boot/*.bb"

BBFILES += "${@d.getVar('BBFILES_SDX') if d.getVar('BASEMACHINE') == 'echo' else d.getVar('BBFILES_IPQ')}"

BBFILE_COLLECTIONS += "ipq"
BBFILE_PATTERN_ipq = "^${LAYERDIR}/"
BBFILE_PRIORITY_ipq = "9"
BB_DANGLINGAPPENDS_WARNONLY ?= "true"
USER_CLASSES:remove = "image-mklibs"
PREFERRED_VERSION_iw = "6.9%"
BBMASK += "meta-rdk-ext/recipes-connectivity/iw"
LAYERSERIES_COMPAT_ipq = "kirkstone scarthgap"
```

## conf/machine/include/ipq-base.inc
```bitbake
SOC_FAMILY = "IPQ"

DEFAULTTUNE ?= "cortexa7thf-neon-vfpv4"
include conf/machine/include/soc-family.inc
include conf/machine/include/tune-cortexa7.inc

IMAGE_FSTYPES = "squashfs squashfs-xz ubi ext4"
MKUBIFS_ARGS = "-m 2048 -e 124KiB -c 4096 -U -F"
UBINIZE_ARGS = "-m 2048 -p 128KiB"

SYSVINIT_ENABLED_GETTYS = ""

KARCH = "arm"
KERNEL_IMAGETYPE ?= "Image"
TARGET_FPU="softfp"

MACHINE_FEATURES += "apm usbhost keyboard squashfs vfat ext2 screen touchscreen bluetooth wifi sdio"

MACHINE_EXTRA_RRECOMMENDS += " kernel-modules"

RDEPENDS_kernel-base = ""
```

## conf/machine/include/ipq-modules.inc
```bitbake
KERNEL_MODULE_AUTOLOAD += "dwc3"
module_autoload_dwc3 = "usbcore usb-common dwc3 phy-qca-baldur phy-qca-uniphy dwc3-ipq40xx dwc3-qcom phy-qcom-qusb2 "

KERNEL_MODULE_AUTOLOAD += "usb-storage"
module_autoload_usb-storage = "usb-storage sd_mod scsi_mod"

KERNEL_MODULE_AUTOLOAD += "phy-qcom-m31"
module_autoload_phy-qcom-m31 = "phy-qcom-m31"

KERNEL_MODULE_AUTOLOAD += "fat"
module_autoload_fat = "fat vfat msdos nls_base nls_cp437 nls_iso8859-1"

KERNEL_MODULE_AUTOLOAD += "ehci-hcd"
module_autoload_ehci-hcd = "ehci-hcd ehci-platform"

KERNEL_MODULE_AUTOLOAD += "xhci-hcd"
module_autoload_xhci-hcd = "xhci-hcd"

KERNEL_MODULE_AUTOLOAD += "xhci-pci"
module_autoload_xhci-pci = "xhci-pci"

KERNEL_MODULE_AUTOLOAD += "xhci-plat-hcd"
module_autoload_xhci-plat-hcd = "xhci-plat-hcd"

KERNEL_MODULE_AUTOLOAD += "leds-gpio"
module_autoload_leds-gpio = "leds-gpio"

KERNEL_MODULE_AUTOLOAD += "cfg80211"
module_autoload_cfg80211 = "cfg80211"

KERNEL_MODULE_AUTOLOAD += "phy-qca-m31"
module_autoload_phy-qca-m31 = "phy-qca-m31"

# net/netfilter kernel loadable modules
KERNEL_MODULE_AUTOLOAD += "ip_tables iptable_filter iptable_mangle iptable_raw xt_nat nf_log_ipv4"
KERNEL_MODULE_AUTOLOAD += "bootconfig libcomposite uas usb_f_diag g_diag  diagchar"

KERNEL_MODULE_AUTOLOAD += "nf_conntrack"
module_autoload_nf_conntrack += "nf_conntrack nf_conntrack_tftp nf_conntrack_amanda nf_conntrack_broadcast \
			nf_conntrack_ftp nf_conntrack_h323 nf_conntrack_irc nf_conntrack_netlink \
			nf_conntrack_pptp nf_conntrack_proto_gre nf_conntrack_sip nf_conntrack_snmp \
			nf_conntrack_tftp nf_nat_amanda nf_nat_ftp nf_nat_irc \
			nf_nat_proto_sctp nf_nat_sip nf_nat_tftp x_tables xt_CT xt_CLASSIFY xt_DSCP xt_ecn xt_HL \
			xt_mac xt_pkttype xt_tcpmss xt_comment xt_esp  xt_quota xt_TCPMSS xt_connbytes \
			xt_helper xt_mark xt_policy xt_recent xt_tcpudp xt_connlimit xt_hl xt_multiport \
			xt_REDIRECT xt_time xt_connmark xt_length xt_nat xt_state xt_conntrack \
			xt_limit xt_owner xt_statistic xt_addrtype xt_dscp xt_DSCP xt_LOG xt_physdev xt_string"


# net/ipv4/netfilter kernel loadable modules
KERNEL_MODULE_AUTOLOAD += "nf_conntrack_ipv4"
module_autoload_nf_conntrack_ipv4 += "nf_conntrack_ipv4 nf_defrag_ipv4"

KERNEL_MODULE_AUTOLOAD += "nf_nat_redirect"
module_autoload_nf_nat_redirect += "nf_nat_redirect nf_nat_ipv4 nf_nat_snmp_basic nf_nat_pptp nf_nat_h323 nf_nat_proto_gre arp_tables \
			   arpt_mangle arptable_filter iptable_filter iptable_mangle iptable_nat \
			   iptable_raw ipt_ah ipt_ECN ipt_MASQUERADE ipt_REJECT"

# net/ipv6/netfilter kernel loadable modules
KERNEL_MODULE_AUTOLOAD += "nf_conntrack_ipv6"
module_autoload_nf_conntrack_ipv6 += "nf_conntrack_ipv6 nf_defrag_ipv6"

KERNEL_MODULE_AUTOLOAD += "ip6_tables ip6table_filter ip6table_mangle ip6table_raw ip6t_REJECT nf_log_ipv6"

# ppp kernel loadable modules
KERNEL_MODULE_AUTOLOAD += "pppoe"
module_autoload_pppoe += "gre crc-ccitt ppp_async ppp_generic pppox pppoe pptp l2tp_ppp"
```

## conf/machine/ipq40xx.conf
```bitbake
#@TYPE: Machine
#@NAME: IPQ40XX machine
#@DESCRIPTION: ipq40xx

include conf/machine/include/ipq-base.inc
include conf/machine/include/ipq-modules.inc

SOC_FAMILY = "ipq:ipq40xx"

MACHINE_FEATURES += "usbhost"

PREFERRED_PROVIDER_virtual/kernel ?= "linux-ipq"

DISTRO_FEATURES_append = " systemd"
DISTRO_FEATURES_BACKFILL_CONSIDERED += "sysvinit"
VIRTUAL-RUNTIME_init_manager = "systemd"
VIRTUAL-RUNTIME_initscripts = "systemd-compat-units"

UBOOT_ARCH = "arm"
UBOOT_MACHINE = "ipq40xx_defconfig"
PREFERRED_PROVIDER_virtual/bootloader ?= "u-boot-2016"
PREFERRED_PROVIDER_u-boot ?= "u-boot-2016"
EXTRA_IMAGEDEPENDS += "u-boot-2016"
INITRAMFS_IMAGE_BUNDLE="1"
KERNEL_IMAGETYPE = "Image"

KERNEL_LOADADDR="0x80208000"
KERNEL_DEVICETREE = "qcom-ipq40??-ap.dk01.1-c1.dtb \
		     qcom-ipq40??-ap.dk01.1-c2.dtb \
		     qcom-ipq40??-ap.dk04.1-c1.dtb \
		     qcom-ipq40??-ap.dk04.1-c2.dtb \
		     qcom-ipq40??-ap.dk04.1-c3.dtb \
		     qcom-ipq40??-ap.dk04.1-c4.dtb \
		     qcom-ipq40??-ap.dk04.1-c5.dtb \
		     qcom-ipq40??-ap.dk05.1-c1.dtb \
		     qcom-ipq40??-ap.dk06.1-c1.dtb \
		     qcom-ipq40??-ap.dk07.1-c1.dtb \
		     qcom-ipq40??-ap.dk07.1-c2.dtb \
		     "

SERIAL_CONSOLE = "115200 ttyMSM0"
```

## conf/machine/ipq52xx.conf
```bitbake
#@TYPE: Machine
#@NAME: IPQ52xX machine
#@DESCRIPTION: ipq52xx

include conf/machine/include/ipq-base.inc
include conf/machine/include/ipq-modules.inc

SOC_FAMILY = "ipq:ipq52xx"
NUM_RADIOS = "radios:3"

MACHINE_FEATURES += "usbhost"

RDEPENDS_${KERNEL_PACKAGE_NAME}-base = ""
PREFERRED_PROVIDER_virtual/kernel ?= "linux-ipq"
PREFERRED_VERSION_lua-native = "5.4.4"
BBMASK .= "|meta-rdk-ext/recipes-connectivity/openssl/openssl_3.0.5.bbappend"

DISTRO_FEATURES:append = " systemd "
DISTRO_FEATURES_BACKFILL_CONSIDERED += "sysvinit"
VIRTUAL-RUNTIME_init_manager = "systemd"
VIRTUAL-RUNTIME_initscripts = "systemd-compat-units"

UBOOT_MACHINE = "ipq5210_norplusnand32_defconfig"
PREFERRED_PROVIDER_virtual/bootloader ?= "u-boot-2025"
PREFERRED_PROVIDER_u-boot ?= "u-boot-2025"
EXTRA_IMAGEDEPENDS += "u-boot-2025"

LINUX_VERSION ?= "6.6"

NITRAMFS_IMAGE_BUNDLE="1"
KERNEL_IMAGETYPE = "Image"
DTB_PATH = 'qcom'

KERNEL_LOADADDR="0x80008000"
KERNEL_DEVICETREE ="ipq5210-emulation.dtb \
		    ipq5210-emulation-fbc.dtb \
"
CONF_VERSION = "2"
SERIAL_CONSOLE = "115200 ttyMSM0"
```

## conf/machine/ipq52xx_64.conf
```bitbake
#@TYPE: Machine
#@NAME: IPQ52xx_64 machine
#@DESCRIPTION: ipq52xx_64

include conf/machine/include/ipq-base.inc
include conf/machine/include/ipq-modules.inc
include conf/machine/include/arm/armv8a/tune-cortexa72.inc

DEFAULTTUNE = "aarch64"
TARGET_ARCH = "aarch64"
KARCH = "arm64"
DTB_PATH = 'qcom'
SOC_FAMILY = "ipq:ipq52xx_64"
NUM_RADIOS = "radios:3"

MACHINE_FEATURES += "usbhost"

RDEPENDS_${KERNEL_PACKAGE_NAME}-base = ""
PREFERRED_PROVIDER_virtual/kernel ?= "linux-ipq"
PREFERRED_VERSION_lua-native = "5.4.4"
BBMASK .= "|meta-rdk-ext/recipes-connectivity/openssl/openssl_3.0.5.bbappend"
PREFERRED_VERSION_iperf3_kirkstone:forcevariable  = "3.17.1"

DISTRO_FEATURES:append = " systemd "
DISTRO_FEATURES_BACKFILL_CONSIDERED += "sysvinit"
VIRTUAL-RUNTIME_init_manager = "systemd"
VIRTUAL-RUNTIME_initscripts = "systemd-compat-units"

UBOOT_MACHINE = "ipq5210_norplusnand_defconfig"
PREFERRED_PROVIDER_virtual/bootloader ?= "u-boot-2025"
PREFERRED_PROVIDER_u-boot ?= "u-boot-2025"
EXTRA_IMAGEDEPENDS += "u-boot-2025"

LINUX_VERSION ?= "6.6"

NITRAMFS_IMAGE_BUNDLE="1"
KERNEL_IMAGETYPE = "Image"

KERNEL_LOADADDR="0x80000000"
KERNEL_DEVICETREE ="ipq5210-emulation.dtb \
		    ipq5210-emulation-fbc.dtb \
		    ipq5210-rdp497.dtb \
		    ipq5210-rdp498.dtb \
		    ipq5210-rdp499.dtb \
		    ipq5210-rdp500.dtb \
		    ipq5210-rdp501.dtb \
		    ipq5210-rdp502.dtb \
		    ipq5210-rdp503.dtb \
		    ipq5210-rdp504.dtb \
		    ipq5210-rdp505.dtb \
		    ipq5210-rdp511.dtb \
		    ipq5210-rdp512.dtb \
		    ipq5210-db-hm01.1.dtb \
		    ipq5210-db-hm02.1.dtb \
"
CONF_VERSION = "2"
SERIAL_CONSOLE = "115200 ttyMSM0"
```

## conf/machine/ipq53xx.conf
```bitbake
#@TYPE: Machine
#@NAME: IPQ53xX machine
#@DESCRIPTION: ipq53xx

include conf/machine/include/ipq-base.inc
include conf/machine/include/ipq-modules.inc

SOC_FAMILY = "ipq:ipq53xx"

MACHINE_FEATURES += "usbhost"

RDEPENDS_${KERNEL_PACKAGE_NAME}-base = ""
PREFERRED_PROVIDER_virtual/kernel ?= "linux-ipq"
PREFERRED_VERSION_lua-native = "5.4.4"
BBMASK .= "|meta-rdk-ext/recipes-connectivity/openssl/openssl_3.0.5.bbappend"

DISTRO_FEATURES:append = " systemd "
DISTRO_FEATURES_BACKFILL_CONSIDERED += "sysvinit"
VIRTUAL-RUNTIME_init_manager = "systemd"
VIRTUAL-RUNTIME_initscripts = "systemd-compat-units"

UBOOT_MACHINE = "ipq5332_norplusnand32_defconfig"
PREFERRED_PROVIDER_virtual/bootloader ?= "u-boot-2023"
PREFERRED_PROVIDER_u-boot ?= "u-boot-2023"
EXTRA_IMAGEDEPENDS += "u-boot-2023"

LINUX_VERSION ?= "6.6"

NITRAMFS_IMAGE_BUNDLE="1"
KERNEL_IMAGETYPE = "Image"
DTB_PATH = 'qcom'

KERNEL_LOADADDR="0x40000000"
KERNEL_DEVICETREE = "ipq5332-rdp441.dtb \
		     ipq5332-rdp442.dtb \
		     ipq5332-rdp446.dtb \
		     ipq5332-rdp468.dtb \
		     ipq5332-rdp472.dtb \
		     ipq5332-rdp473.dtb \
		     ipq5332-rdp474.dtb \
		     ipq5332-rdp477.dtb \
		     ipq5332-rdp478.dtb \
		     ipq5332-rdp479.dtb \
		     ipq5332-rdp480.dtb \
		     ipq5332-rdp481.dtb \
		     ipq5332-rdp483.dtb \
		     ipq5332-rdp484.dtb \
		     ipq5332-rdp486.dtb \
                    "
CONF_VERSION = "2"
SERIAL_CONSOLE = "115200 ttyMSM0"
```

## conf/machine/ipq53xx_64.conf
```bitbake
#@TYPE: Machine
#@NAME: IPQ53xx_64 machine
#@DESCRIPTION: ipq53xx_64

include conf/machine/include/ipq-base.inc
include conf/machine/include/ipq-modules.inc
include conf/machine/include/arm/armv8a/tune-cortexa72.inc

DEFAULTTUNE = "aarch64"
TARGET_ARCH = "aarch64"
KARCH = "arm64"
DTB_PATH = 'qcom'
SOC_FAMILY = "ipq:ipq53xx_64"

MACHINE_FEATURES += "usbhost"

RDEPENDS_${KERNEL_PACKAGE_NAME}-base = ""
PREFERRED_PROVIDER_virtual/kernel ?= "linux-ipq"
PREFERRED_VERSION_lua-native = "5.4.4"

DISTRO_FEATURES:append = " systemd "
DISTRO_FEATURES_BACKFILL_CONSIDERED += "sysvinit"
VIRTUAL-RUNTIME_init_manager = "systemd"
VIRTUAL-RUNTIME_initscripts = "systemd-compat-units"

UBOOT_MACHINE = "ipq5332_norplusnand_defconfig"
PREFERRED_PROVIDER_virtual/bootloader ?= "u-boot-2023"
PREFERRED_PROVIDER_u-boot ?= "u-boot-2023"
EXTRA_IMAGEDEPENDS += "u-boot-2023"

LINUX_VERSION ?= "6.6"

NITRAMFS_IMAGE_BUNDLE="1"
KERNEL_IMAGETYPE = "Image"

KERNEL_LOADADDR="0x40000000"
KERNEL_DEVICETREE = "ipq5332-rdp441.dtb \
		     ipq5332-rdp442.dtb \
		     ipq5332-rdp446.dtb \
		     ipq5332-rdp468.dtb \
		     ipq5332-rdp472.dtb \
		     ipq5332-rdp473.dtb \
		     ipq5332-rdp474.dtb \
		     ipq5332-rdp477.dtb \
		     ipq5332-rdp478.dtb \
		     ipq5332-rdp479.dtb \
		     ipq5332-rdp480.dtb \
		     ipq5332-rdp481.dtb \
		     ipq5332-rdp483.dtb \
		     ipq5332-rdp484.dtb \
		     ipq5332-rdp486.dtb \
                    "
CONF_VERSION = "2"
SERIAL_CONSOLE = "115200 ttyMSM0"
```

## conf/machine/ipq54xx.conf
```bitbake
#@TYPE: Machine
#@NAME: IPQ54xX machine
#@DESCRIPTION: ipq54xx

include conf/machine/include/ipq-base.inc
include conf/machine/include/ipq-modules.inc

SOC_FAMILY = "ipq:ipq54xx"
NUM_RADIOS = "radios:3"

MACHINE_FEATURES += "usbhost"

RDEPENDS_${KERNEL_PACKAGE_NAME}-base = ""
PREFERRED_PROVIDER_virtual/kernel ?= "linux-ipq"
PREFERRED_VERSION_lua-native = "5.4.4"
BBMASK .= "|meta-rdk-ext/recipes-connectivity/openssl/openssl_3.0.5.bbappend"

DISTRO_FEATURES:append = " systemd "
DISTRO_FEATURES_BACKFILL_CONSIDERED += "sysvinit"
VIRTUAL-RUNTIME_init_manager = "systemd"
VIRTUAL-RUNTIME_initscripts = "systemd-compat-units"

UBOOT_MACHINE = "ipq5424_norplusnand32_defconfig"
PREFERRED_PROVIDER_virtual/bootloader ?= "u-boot-2025"
PREFERRED_PROVIDER_u-boot ?= "u-boot-2025"
EXTRA_IMAGEDEPENDS += "u-boot-2025"

LINUX_VERSION ?= "6.6"

NITRAMFS_IMAGE_BUNDLE="1"
KERNEL_IMAGETYPE = "Image"
DTB_PATH = 'qcom'

KERNEL_LOADADDR="0x80008000"
KERNEL_DEVICETREE ="ipq5424-rdp464.dtb \
		    ipq5424-rdp464-c2.dtb \
		    ipq5424-rdp496.dtb \
		    ipq5424-rdp466.dtb \
		    ipq5424-rdp466-c2.dtb \
		    ipq5424-rdp466-c3.dtb \
		    ipq5424-rdp466-rffe.dtb \
		    ipq5424-rdp485.dtb \
		    ipq5424-rdp485-c2.dtb \
		    ipq5424-rdp485-c3.dtb \
		    ipq5424-rdp485-rffe.dtb \
		    ipq5424-rdp487.dtb \
		    ipq5424-db-mr01.1.dtb \
                    ipq5424-rdp464-c3.dtb \
                    ipq5424-rdp464-c4.dtb \
                    ipq5424-rdp492.dtb \
                    ipq5424-rdp464-qce2204.dtb \
                    ipq5424-rdp508.dtb \
                    ipq5424-rdp485-c4.dtb \
                    ipq5424-rdp487-c2.dtb \
                    ipq5424-rdp487-c3.dtb \
"
CONF_VERSION = "2"
SERIAL_CONSOLE = "115200 ttyMSM0"
```

## conf/machine/ipq54xx_64.conf
```bitbake
#@TYPE: Machine
#@NAME: IPQ54xx_64 machine
#@DESCRIPTION: ipq54xx_64

include conf/machine/include/ipq-base.inc
include conf/machine/include/ipq-modules.inc
include conf/machine/include/arm/armv8a/tune-cortexa72.inc

DEFAULTTUNE = "aarch64"
TARGET_ARCH = "aarch64"
KARCH = "arm64"
DTB_PATH = 'qcom'
SOC_FAMILY = "ipq:ipq54xx_64"
NUM_RADIOS = "radios:3"

MACHINE_FEATURES += "usbhost"

RDEPENDS_${KERNEL_PACKAGE_NAME}-base = ""
PREFERRED_PROVIDER_virtual/kernel ?= "linux-ipq"
PREFERRED_VERSION_lua-native = "5.4.4"
BBMASK .= "|meta-rdk-ext/recipes-connectivity/openssl/openssl_3.0.5.bbappend"

DISTRO_FEATURES:append = " systemd "
DISTRO_FEATURES_BACKFILL_CONSIDERED += "sysvinit"
VIRTUAL-RUNTIME_init_manager = "systemd"
VIRTUAL-RUNTIME_initscripts = "systemd-compat-units"

UBOOT_MACHINE = "ipq5424_norplusnand_defconfig"
PREFERRED_PROVIDER_virtual/bootloader ?= "u-boot-2025"
PREFERRED_PROVIDER_u-boot ?= "u-boot-2025"
EXTRA_IMAGEDEPENDS += "u-boot-2025"

LINUX_VERSION ?= "6.6"

NITRAMFS_IMAGE_BUNDLE="1"
KERNEL_IMAGETYPE = "Image"

KERNEL_LOADADDR="0x80000000"
KERNEL_DEVICETREE ="ipq5424-rdp464.dtb \
		    ipq5424-rdp464-c2.dtb \
		    ipq5424-rdp496.dtb \
		    ipq5424-rdp466.dtb \
		    ipq5424-rdp466-c2.dtb \
		    ipq5424-rdp466-c3.dtb \
		    ipq5424-rdp466-rffe.dtb \
		    ipq5424-rdp485.dtb \
		    ipq5424-rdp485-c2.dtb \
		    ipq5424-rdp485-c3.dtb \
		    ipq5424-rdp485-rffe.dtb \
		    ipq5424-rdp487.dtb \
		    ipq5424-db-mr01.1.dtb \
"
CONF_VERSION = "2"
SERIAL_CONSOLE = "115200 ttyMSM0"
```
