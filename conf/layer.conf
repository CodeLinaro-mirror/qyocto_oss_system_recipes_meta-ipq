## conf/machine/ipq807x.conf
```bitbake
#@TYPE: Machine
#@NAME: IPQ807X machine
#@DESCRIPTION: ipq807x

include conf/machine/include/ipq-base.inc
include conf/machine/include/ipq-modules.inc

SOC_FAMILY = "ipq:ipq807x"

MACHINE_FEATURES += "usbhost"

RDEPENDS_${KERNEL_PACKAGE_NAME}-base = ""
PREFERRED_PROVIDER_virtual/kernel ?= "linux-ipq"

DISTRO_FEATURES_append = " systemd"
DISTRO_FEATURES_BACKFILL_CONSIDERED += "sysvinit"
VIRTUAL-RUNTIME_init_manager = "systemd"
VIRTUAL-RUNTIME_initscripts = "systemd-compat-units"

UBOOT_ARCH = "arm"
UBOOT_MACHINE = "ipq807x_defconfig"
PREFERRED_PROVIDER_virtual/bootloader ?= "u-boot-2016"
PREFERRED_PROVIDER_u-boot ?= "u-boot-2016"
EXTRA_IMAGEDEPENDS += "u-boot-2016"
INITRAMFS_IMAGE_BUNDLE="1"
KERNEL_IMAGETYPE = "Image"
LINUX_VERSION ?= "5.4"

KERNEL_LOADADDR="0x41208000"
KERNEL_DEVICETREE = "ipq8074-hk01.dtb \
		     ipq8074-hk01.c2.dtb \
		     ipq8074-hk01.c3.dtb \
                     ipq8074-hk01.c4.dtb \
                     ipq8074-hk01.c5.dtb \
                     ipq8074-hk02.dtb \
                     ipq8074-hk06.dtb \
                     ipq8074-hk07.dtb \
                     ipq8074-hk08.dtb \
                     ipq8074-hk09.dtb \
                     ipq8074-hk10.dtb \
                     ipq8074-hk10.c2.dtb \
                     ipq8074-hk14.dtb \
                     ipq8074-ac01.dtb \
                     ipq8074-ac02.dtb \
                     ipq8074-oak02.dtb \
                     ipq8074-oak03.dtb \
                     ipq8074-db.hk02.dtb \
		    "

SERIAL_CONSOLE = "115200 ttyMSM0"
```

## conf/machine/ipq807x_64.conf
```bitbake
#@TYPE: Machine
#@NAME: IPQ807X_64 machine
#@DESCRIPTION: ipq807x_64

include conf/machine/include/ipq-base.inc
include conf/machine/include/ipq-modules.inc
include conf/machine/include/arm/arch-arm64.inc

DEFAULTTUNE = "aarch64"
TARGET_ARCH = "aarch64"
KARCH = "arm64"
DTB_PATH = "qcom"

SOC_FAMILY = "ipq:ipq807x_64"

MACHINE_FEATURES += "usbhost"

PREFERRED_PROVIDER_virtual/kernel ?= "linux-ipq"

DISTRO_FEATURES_append = " systemd"
DISTRO_FEATURES_BACKFILL_CONSIDERED += "sysvinit"
VIRTUAL-RUNTIME_init_manager = "systemd"
VIRTUAL-RUNTIME_initscripts = "systemd-compat-units"

UBOOT_ARCH = "arm"
UBOOT_MACHINE = "ipq807x_defconfig"
PREFERRED_PROVIDER_u-boot ?= "u-boot-2016"
INITRAMFS_IMAGE_BUNDLE="1"
KERNEL_IMAGETYPE = "Image"

KERNEL_LOADADDR="0x41080000"
KERNEL_DEVICETREE = "ipq8074-hk01.dtb \
                     ipq8074-hk01.c2.dtb \
                     ipq8074-hk01.c3.dtb \
                     ipq8074-hk01.c4.dtb \
                     ipq8074-hk02.dtb \
                     ipq8074-hk06.dtb \
                     ipq8074-hk07.dtb \
                     ipq8074-hk08.dtb \
                     ipq8074-hk09.dtb \
                     ipq8074-hk10.dtb \
                     ipq8074-hk10.c2.dtb \
                     ipq8074-hk14.dtb \
                     ipq8074-ac01.dtb \
                     ipq8074-ac02.dtb \
                     ipq8074-oak02.dtb \
                     ipq8074-oak03.dtb \
		    "

SERIAL_CONSOLE = "115200 ttyMSM0"
```

## conf/machine/ipq95xx.conf
```bitbake
#@TYPE: Machine
#@NAME: IPQ95xX machine
#@DESCRIPTION: ipq95xx

include conf/machine/include/ipq-base.inc
include conf/machine/include/ipq-modules.inc

SOC_FAMILY = "ipq:ipq95xx"

MACHINE_FEATURES += "usbhost"

RDEPENDS_${KERNEL_PACKAGE_NAME}-base = ""
PREFERRED_PROVIDER_virtual/kernel ?= "linux-ipq"
PREFERRED_VERSION_lua-native = "5.4.4"

DISTRO_FEATURES:append = " systemd "
DISTRO_FEATURES_BACKFILL_CONSIDERED += "sysvinit"
VIRTUAL-RUNTIME_init_manager = "systemd"
VIRTUAL-RUNTIME_initscripts = "systemd-compat-units"

UBOOT_ARCH = "arm"
#UBOOT_MACHINE = "ipq9574_defconfig"
UBOOT_MACHINE = "ipq9574_norplusnand_defconfig"
PREFERRED_PROVIDER_virtual/bootloader ?= "u-boot-2023"
PREFERRED_PROVIDER_u-boot ?= "u-boot-2023"
EXTRA_IMAGEDEPENDS += "u-boot-2023"
NITRAMFS_IMAGE_BUNDLE="1"
KERNEL_IMAGETYPE = "Image"
LINUX_VERSION ?= "6.6"
DTB_PATH = 'qcom'


KERNEL_LOADADDR="0x40000000"
KERNEL_DEVICETREE ="ipq9574-rdp476.dtb \
		    ipq9574-rdp475.dtb \
		    ipq9574-rdp469.dtb \
		    ipq9574-rdp467.dtb \
		    ipq9574-rdp461.dtb \
		    ipq9574-rdp459.dtb \
		    ipq9574-rdp458.dtb \
		    ipq9574-rdp457.dtb \
		    ipq9574-rdp456.dtb \
		    ipq9574-rdp455-c12.dtb \
		    ipq9574-rdp455-c11.dtb \
		    ipq9574-rdp454.dtb \
		    ipq9574-rdp453.dtb \
		    ipq9574-rdp449.dtb \
		    ipq9574-rdp437.dtb \
		    ipq9574-rdp433-mht-switch.dtb \
		    ipq9574-rdp433-mht-phy.dtb \
		    ipq9574-rdp433.dtb \
		    ipq9574-rdp418.dtb \
		    ipq9574-rdp417.dtb \
		    ipq9574-db-al02-c3.dtb \
		    ipq9574-db-al02-c2.dtb \
		    ipq9574-db-al02-c1.dtb \
		    ipq9574-db-al01-c3.dtb \
		    ipq9574-db-al01-c2.dtb \
		    ipq9574-db-al01-c1.dtb \
                    "
CONF_VERSION = "2"
SERIAL_CONSOLE = "115200 ttyMSM0"
```

## conf/machine/ipq95xx_64.conf
```bitbake
#@TYPE: Machine
#@NAME: IPQ95xx_64 machine
#@DESCRIPTION: ipq95xx_64

include conf/machine/include/ipq-base.inc
include conf/machine/include/ipq-modules.inc
include conf/machine/include/arm/armv8a/tune-cortexa72.inc

DEFAULTTUNE = "aarch64"
TARGET_ARCH = "aarch64"
KARCH = "arm64"
DTB_PATH = 'qcom'
SOC_FAMILY = "ipq:ipq95xx_64"
NUM_RADIOS = "radios:3"

MACHINE_FEATURES += "usbhost"

RDEPENDS_${KERNEL_PACKAGE_NAME}-base = ""
PREFERRED_PROVIDER_virtual/kernel ?= "linux-ipq"
PREFERRED_VERSION_lua-native = "5.4.4"
BBMASK .= "|meta-rdk-ext/recipes-connectivity/openssl/openssl_3.0.5.bbappend"

DISTRO_FEATURES:append = " systemd "
DISTRO_FEATURES_BACKFILL_CONSIDERED += "sysvinit"
VIRTUAL-RUNTIME_init_manager = "systemd"
VIRTUAL-RUNTIME_initscripts = "systemd-compat-units"

UBOOT_MACHINE = "ipq9574_norplusnand_defconfig"
PREFERRED_PROVIDER_virtual/bootloader ?= "u-boot-2025"
PREFERRED_PROVIDER_u-boot ?= "u-boot-2025"
EXTRA_IMAGEDEPENDS += "u-boot-2025"

LINUX_VERSION ?= "6.6"

NITRAMFS_IMAGE_BUNDLE="1"
KERNEL_IMAGETYPE = "Image"

KERNEL_LOADADDR="0x40000000"
KERNEL_DEVICETREE ="ipq9574-rdp476.dtb \
		    ipq9574-rdp475.dtb \
		    ipq9574-rdp469.dtb \
		    ipq9574-rdp467.dtb \
		    ipq9574-rdp461.dtb \
		    ipq9574-rdp459.dtb \
		    ipq9574-rdp458.dtb \
		    ipq9574-rdp457.dtb \
		    ipq9574-rdp456.dtb \
		    ipq9574-rdp455-c12.dtb \
		    ipq9574-rdp455-c11.dtb \
		    ipq9574-rdp454.dtb \
		    ipq9574-rdp453.dtb \
		    ipq9574-rdp449.dtb \
		    ipq9574-rdp437.dtb \
		    ipq9574-rdp433-mht-switch.dtb \
		    ipq9574-rdp433-mht-phy.dtb \
		    ipq9574-rdp433.dtb \
		    ipq9574-rdp418.dtb \
		    ipq9574-rdp417.dtb \
		    ipq9574-db-al02-c3.dtb \
		    ipq9574-db-al02-c2.dtb \
		    ipq9574-db-al02-c1.dtb \
		    ipq9574-db-al01-c3.dtb \
		    ipq9574-db-al01-c2.dtb \
		    ipq9574-db-al01-c1.dtb \
                    "
CONF_VERSION = "2"
SERIAL_CONSOLE = "115200 ttyMSM0"
```

## conf/machine/ipq96xx.conf
```bitbake
#@TYPE: Machine
#@NAME: IPQ96xX machine
#@DESCRIPTION: ipq96xx

include conf/machine/include/ipq-base.inc
include conf/machine/include/ipq-modules.inc

SOC_FAMILY = "ipq:ipq96xx"
NUM_RADIOS = "radios:3"

MACHINE_FEATURES += "usbhost"

RDEPENDS_${KERNEL_PACKAGE_NAME}-base = ""
PREFERRED_PROVIDER_virtual/kernel ?= "linux-ipq"
PREFERRED_VERSION_lua-native = "5.4.4"
BBMASK .= "|meta-rdk-ext/recipes-connectivity/openssl/openssl_3.0.5.bbappend"

DISTRO_FEATURES:append = " systemd "
DISTRO_FEATURES_BACKFILL_CONSIDERED += "sysvinit"
VIRTUAL-RUNTIME_init_manager = "systemd"
VIRTUAL-RUNTIME_initscripts = "systemd-compat-units"

UBOOT_MACHINE = "ipq9650_norplusnand32_defconfig"
PREFERRED_PROVIDER_virtual/bootloader ?= "u-boot-2025"
PREFERRED_PROVIDER_u-boot ?= "u-boot-2025"
EXTRA_IMAGEDEPENDS += "u-boot-2025"

LINUX_VERSION ?= "6.6"

NITRAMFS_IMAGE_BUNDLE="1"
KERNEL_IMAGETYPE = "Image"
DTB_PATH = 'qcom'

KERNEL_LOADADDR="0x80008000"
KERNEL_DEVICETREE ="ipq9650-db-ju01.dtb \
                    ipq9650-db-ju02.dtb \
                    ipq9650-db-ju01-c1.dtb \
                    ipq9650-db-ju01-c2.dtb \
                    ipq9650-emulation.dtb \
                    ipq9650-emulation-fbc.dtb \
                    ipq9650-rdp488.dtb \
                    ipq9650-rdp489.dtb \
                    ipq9650-rdp506.dtb \
                    ipq9650-rdp490.dtb \
                    ipq9650-rdp491.dtb \
                    ipq9650-rdp507.dtb \
                    ipq9650-rdp529.dtb \
                    ipq9650-rdp530.dtb \
                    ipq9650-rdp532.dtb \
                    ipq9650-tb-ju01.1.dtb \
"
CONF_VERSION = "2"
SERIAL_CONSOLE = "115200 ttyMSM0"
```

## conf/machine/ipq96xx_64.conf
```bitbake
#@TYPE: Machine
#@NAME: IPQ96xx_64 machine
#@DESCRIPTION: ipq96xx_64

include conf/machine/include/ipq-base.inc
include conf/machine/include/ipq-modules.inc
include conf/machine/include/arm/armv8a/tune-cortexa72.inc

DEFAULTTUNE = "aarch64"
TARGET_ARCH = "aarch64"
KARCH = "arm64"
DTB_PATH = 'qcom'
SOC_FAMILY = "ipq:ipq96xx_64"
NUM_RADIOS = "radios:3"

MACHINE_FEATURES += "usbhost"

RDEPENDS_${KERNEL_PACKAGE_NAME}-base = ""
PREFERRED_PROVIDER_virtual/kernel ?= "linux-ipq"
PREFERRED_VERSION_lua-native = "5.4.4"
BBMASK .= "|meta-rdk-ext/recipes-connectivity/openssl/openssl_3.0.5.bbappend"
PREFERRED_VERSION_iperf3_kirkstone:forcevariable  = "3.17.1"

DISTRO_FEATURES:append = " systemd "
DISTRO_FEATURES_BACKFILL_CONSIDERED += "sysvinit"
VIRTUAL-RUNTIME_init_manager = "systemd"
VIRTUAL-RUNTIME_initscripts = "systemd-compat-units"

UBOOT_MACHINE = "ipq9650_norplusnand_defconfig"
PREFERRED_PROVIDER_virtual/bootloader ?= "u-boot-2025"
PREFERRED_PROVIDER_u-boot ?= "u-boot-2025"
EXTRA_IMAGEDEPENDS += "u-boot-2025"

LINUX_VERSION ?= "6.6"

NITRAMFS_IMAGE_BUNDLE="1"
KERNEL_IMAGETYPE = "Image"

KERNEL_LOADADDR="0x80000000"
KERNEL_DEVICETREE ="ipq9650-db-ju01.dtb \
		    ipq9650-db-ju02.dtb \
		    ipq9650-db-ju01-c1.dtb \
		    ipq9650-db-ju01-c2.dtb \
		    ipq9650-emulation.dtb \
		    ipq9650-emulation-fbc.dtb \
		    ipq9650-rdp488.dtb \
		    ipq9650-rdp489.dtb \
		    ipq9650-rdp506.dtb \
		    ipq9650-rdp490.dtb \
		    ipq9650-rdp491.dtb \
		    ipq9650-rdp507.dtb \
		    ipq9650-rdp529.dtb \
		    ipq9650-rdp530.dtb \
		    ipq9650-rdp532.dtb \
		    ipq9650-tb-ju01.1.dtb \
"
CONF_VERSION = "2"
SERIAL_CONSOLE = "115200 ttyMSM0"
```
